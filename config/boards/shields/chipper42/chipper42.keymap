#define K42 &none
#define K34 &none
#define K28 &none
#define K22 &none
#define K18 &none

/* source keypos definitions */
#include "../../../zmk-helpers/key-labels/42.h"

/* fix urob */
#undef  LH1
#define LH1 LH2
#undef  LH0
#define LH0 LH1

#undef  RH1
#define RH1 RH2
#undef  RH0
#define RH0 RH1

/* source the main keymap */
#include "base.keymap"

/* use 6-column layout*/
/ { chosen { zmk,matrix_transform = &default_transform; }; };
